## Kconfig.board
```kconfig
# SAM E54 Xplained Pro Board configuration
#
# Copyright (c) 2019 Benjamin Valentin
# SPDX-License-Identifier: Apache-2.0
# Modified 2023 by Sebastian Schlupp for ATSAME51J20
# Redistributed under the same (Apache-2.0) license

config BOARD_ATSAME51_CNANO
	bool "SAM E51 Curiosity Nano"
	depends on SOC_PART_NUMBER_SAME51J20A
```

## atsame51_cnano_defconfig
```kconfig
# Copyright (c) 2019 Benjamin Valentin
# SPDX-License-Identifier: Apache-2.0
# Modified 2023 by Sebastian Schlupp for ATSAME51J20
# Redistributed under the same (Apache-2.0) license

CONFIG_SOC_SERIES_SAME51=y
CONFIG_SOC_PART_NUMBER_SAME51J20A=y
CONFIG_SOC_ATMEL_SAMD5X_XOSC32K=y
CONFIG_SOC_ATMEL_SAMD5X_XOSC32K_AS_MAIN=y
CONFIG_BOARD_ATSAME51_CNANO=y
CONFIG_BUILD_OUTPUT_HEX=y

CONFIG_ARM_MPU=y
CONFIG_HW_STACK_PROTECTION=y

CONFIG_CONSOLE=y
CONFIG_GPIO=y
CONFIG_SERIAL=y
CONFIG_UART_CONSOLE=y
CONFIG_UART_INTERRUPT_DRIVEN=y
```
